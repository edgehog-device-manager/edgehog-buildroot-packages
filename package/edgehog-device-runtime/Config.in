## package/edgehog-device-runtime/Config.in
```kconfig
#
# Copyright 2022-2024 SECO Mind Srl
#
# SPDX-License-Identifier: Apache-2.0
#

config BR2_PACKAGE_EDGEHOG_DEVICE_RUNTIME
            bool "edgehog-device-runtime"
            depends on BR2_PACKAGE_HOST_RUSTC_TARGET_ARCH_SUPPORTS
            depends on BR2_PACKAGE_HAS_UDEV
            depends on BR2_PACKAGE_DBUS
            depends on BR2_FORTIFY_SOURCE_NONE
            select BR2_PACKAGE_EDGEHOG_ASTARTE_INTERFACE
            select BR2_PACKAGE_UPOWER
            select BR2_PACKAGE_CA_CERTIFICATES
            select BR2_PACKAGE_HOST_RUSTC
            select BR2_PACKAGE_SQLITE
            default y
            help
              This is a portable middleware written in Rust, that enables remote device management
              on Linux-based systems.

              https://github.com/edgehog-device-manager/edgehog-device-runtime

if BR2_PACKAGE_EDGEHOG_DEVICE_RUNTIME
    choice
        prompt "Select an astarte library"
        default BR2_PACKAGE_EDGEHOG_DEVICE_RUNTIME_ASTARTE_LIBRARY_ASTARTE_DEVICE_SDK
        help
                Edgehog Device Runtime supports following libraries to communicate with the remote Edgehog
                instance.

        config BR2_PACKAGE_EDGEHOG_DEVICE_RUNTIME_ASTARTE_LIBRARY_ASTARTE_DEVICE_SDK
            bool "astarte-device-sdk"
            help
                    The Astarte Device SDK for Rust is a ready to use library that provides communication and pairing
                    primitives to an Astarte Cluster.

        config BR2_PACKAGE_EDGEHOG_DEVICE_RUNTIME_ASTARTE_LIBRARY_ASTARTE_MESSAGE_HUB
            bool "astarte-message-hub"
            depends on BR2_PACKAGE_ASTARTE_MESSAGE_HUB
            help
                    A central service that runs on (Linux) devices for collecting and delivering messages from N apps
                    using 1 MQTT connection to Astarte.
    endchoice

    config BR2_PACKAGE_EDGEHOG_DEVICE_RUNTIME_ASTARTE_REALM
      string "Astarte realm"
      default "test"
      help
            The realm to be used use in Astarte requests.

    config BR2_PACKAGE_EDGEHOG_DEVICE_RUNTIME_ASTARTE_PAIRING_BASE_URL
        string "Astarte pairing base URL"
        default "http://localhost:4003"
        help
            The base URL to reach Astarte Pairing API.This should be the URL up to (and excluding) /v1.

    config BR2_PACKAGE_EDGEHOG_DEVICE_RUNTIME_ASTARTE_PAIRING_JWT
        string "Pairing JWT token"
        default ""
        help
            JWT token to authorize device registration.

            Can be obtained with ./generate-astarte-credentials -t pairing -p yourrealmkey.key

    config BR2_PACKAGE_EDGEHOG_DEVICE_RUNTIME_ASTARTE_CREDENTIAL_SECRET
        string "Astarte credential secret"
        default ""
        help
            Credential secret to authorize the device.

            Can be obtained by manually registering the device in Astarte.

    config BR2_PACKAGE_EDGEHOG_DEVICE_RUNTIME_ASTARTE_DEVICE_ID
        string "Astarte Device ID"
        default ""
        help
            Astarte identifies each device with a 128 bit Device ID which has to be unique within its Realm

    config BR2_PACKAGE_EDGEHOG_DEVICE_RUNTIME_ASTARTE_IGNORE_SSL
        bool "Ignore SSL errors from Astarte"
        help
            Ignore SSL errors from the Astarte API or MQTT broker.

            This allows using a local Astarte instance or connectig to the API
            through HTTP or using a self-signed certificate.

    config BR2_PACKAGE_EDGEHOG_DEVICE_RUNTIME_ASTARTE_MESSAGE_HUB_ENDPOINT
        string "Astarte Message Hub enpoint"
        default "http://[::1]:50051"
        depends on BR2_PACKAGE_ASTARTE_MESSAGE_HUB
        help
            Endpoint to connect edgehog-device-runtime with Astarte Message Hub

    config BR2_PACKAGE_EDGEHOG_DEVICE_RUNTIME_SERIAL_NUMBER
        string "Edgehog serial number"
        default ""
        help
            Serial number for the device, sent as telemetry to Astarte

    config BR2_PACKAGE_EDGEHOG_DEVICE_RUNTIME_PART_NUMBER
        string "Edgehog part number"
        default ""
        help
            Part number for the device, sent as telemetry to Astarte

    config BR2_PACKAGE_EDGEHOG_DEVICE_RUNTIME_IMAGE_VERSION
        string "Edgehog image version"
        default ""
        help
            Image version that will be appended to the /etc/os-release file.

    config BR2_PACKAGE_EDGEHOG_DEVICE_RUNTIME_FORWARDER
        bool "Enable devide forwarder"
        select BR2_PACKAGE_TTYD
        help
            Enable forwarder functionality on a device.

	config BR2_PACKAGE_EDGEHOG_DEVICE_RUNTIME_FORWARDER_COMMAND
		string "TTYD command"
		default "login"
		depends on BR2_PACKAGE_EDGEHOG_DEVICE_RUNTIME_FORWARDER
		help
			TTYD command to execute
endif
```
